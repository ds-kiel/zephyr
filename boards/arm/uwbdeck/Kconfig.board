## boards/arm/uwbdeck/Kconfig.board
```kconfig
# DS-Kiel Uwbdeck board configuration

# Copyright (c) 2024 Lasse Züngel, Christian Richter
# SPDX-License-Identifier: Apache-2.0

config BOARD_UWBDECK
	bool "DS-Kiel Uwbdeck"
	depends on SOC_NRF52840_QFAA
```

## boards/arm/uwbdeck/Kconfig.defconfig
```kconfig
if BOARD_UWBDECK

config BOARD
	default "uwbdeck"

config BT_CTLR
	default BT

config SPI
	default y
	depends on IEEE802154


endif # BOARD_UWBDECK
```
